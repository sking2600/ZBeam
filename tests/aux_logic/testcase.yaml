## tests/aux_logic/testcase.yaml
```yaml
common:
  platform_allow: [esp32c3_supermini]
  tags:
    - zbeam
    - logic
  harness: unit
tests:
  logic.aux:
    min_ram: 16
```

## tests/batt_check/testcase.yaml
```yaml
common:
  platform_allow: [esp32c3_supermini]
  tags:
    - zbeam
    - logic
  harness: unit
tests:
  logic.batt:
    min_ram: 16
```

## tests/fsm_core/testcase.yaml
```yaml
common:
  platform_allow: [esp32c3_supermini]
  tags:
    - zbeam
    - fsm
  harness: console
  harness_config:
    type: one_line
    regex:
      - ".*ZBeam.*"
tests:
  fsm.core:
    extra_configs:
      - CONFIG_ZBEAM_DEFAULT_UI_MODE_ADVANCED=y
```

## tests/fsm_nvs/testcase.yaml
```yaml
common:
  platform_allow: [esp32c3_supermini]
  tags:
    - zbeam
    - fsm
  harness: console
  harness_config:
    type: one_line
    regex:
      - ".*ZBeam.*"
tests:
  fsm.nvs:
    extra_configs:
      - CONFIG_ZBEAM_NVS_ENABLED=y
```

## tests/input_logic/testcase.yaml
```yaml
common:
  platform_allow: [esp32c3_supermini]
  tags:
    - zbeam
    - logic
  harness: unit
tests:
  logic.input:
    min_ram: 16
```

## tests/nvs_logic/testcase.yaml
```yaml
common:
  platform_allow: [esp32c3_supermini]
  tags:
    - zbeam
    - logic
  harness: unit
tests:
  logic.nvs:
    min_ram: 16
    extra_configs:
      - CONFIG_ZBEAM_NVS_ENABLED=y
```

## tests/strobe_logic/testcase.yaml
```yaml
common:
  platform_allow: [esp32c3_supermini]
  tags:
    - zbeam
    - logic
  harness: unit
tests:
  logic.strobe:
    min_ram: 16
```
